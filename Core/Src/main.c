/* USER CODE BEGIN Header */
/**
  ******************************************************************************
  * @file           : main.c
  * @brief          : Main program body
  ******************************************************************************
  * @attention
  *
  * Copyright (c) 2025 STMicroelectronics.
  * All rights reserved.
  *
  * This software is licensed under terms that can be found in the LICENSE file
  * in the root directory of this software component.
  * If no LICENSE file comes with this software, it is provided AS-IS.
  *
  ******************************************************************************
  */
/* USER CODE END Header */
/* Includes ------------------------------------------------------------------*/
#include "main.h"
#include "i2c.h"
#include "tim.h"
#include "gpio.h"

/* Private includes ----------------------------------------------------------*/
/* USER CODE BEGIN Includes */

uint32_t IC_Vrijednost1 = 0;
uint32_t IC_Vrijednost2 = 0;
uint32_t Razlika = 0;
uint8_t Zabiljezeno = 0;
uint8_t Udaljenost  = 0;

char Udaljenost_ch[5];

const uint16_t Font11x18 [] = {
	0x0000, 0x0000, 0x0000, 0x0000, 0x0000, 0x0000, 0x0000, 0x0000, 0x0000, 0x0000, 0x0000, 0x0000, 0x0000, 0x0000, 0x0000, 0x0000, 0x0000, 0x0000,   // razmak
	0x0000, 0x0C00, 0x0C00, 0x0C00, 0x0C00, 0x0C00, 0x0C00, 0x0C00, 0x0C00, 0x0C00, 0x0C00, 0x0C00, 0x0000, 0x0C00, 0x0C00, 0x0000, 0x0000, 0x0000,   // !
	0x0000, 0x1B00, 0x1B00, 0x1B00, 0x1B00, 0x1B00, 0x0000, 0x0000, 0x0000, 0x0000, 0x0000, 0x0000, 0x0000, 0x0000, 0x0000, 0x0000, 0x0000, 0x0000,   // "
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	0x0000, 0x0000, 0x0000, 0x0000, 0x0000, 0x0000, 0x0000, 0x3880, 0x7F80, 0x4700, 0x0000, 0x0000, 0x0000, 0x0000, 0x0000, 0x0000, 0x0000, 0x0000,   // ~
};

typedef struct {
	uint8_t Font_W;    // Širina fonta
	uint8_t Font_H;   // Visina fonta
	const uint16_t *data; // Pointer data
} FontDef_t;

FontDef_t Font_11x18 = {
	11,
	18,
	Font11x18
};

typedef enum {
	OLED_CRNA = 0x00, // Crni piksel
	OLED_BIJELA = 0x01  // Piksel je postavljen
} OLED_BOJA_t;

#define OLED_W 128
#define OLED_H 64

static uint8_t OLED_Buffer[OLED_W * OLED_H / 8];

typedef struct {
	uint16_t X;
	uint16_t Y;
	uint8_t Obrnuto;
	uint8_t Inicijalizirano;
} OLED_t;

static OLED_t OLED;

#define OLED_I2C_ADDR 0x78
#define OLED_I2C &hi2c1
#define OLED_DEAKTIVIRAJ_SCROLL 0x2E
#define OLED_WRITECOMMAND(command) OLED_I2C_Ispis(OLED_I2C_ADDR, 0x00, (command))

void OLED_I2C_Init() {
	uint32_t p = 250000;
	while(p>0)
		p--;
}

void OLED_I2C_Ispis(uint8_t address, uint8_t reg, uint8_t data) {
	uint8_t dt[2];
	dt[0] = reg;
	dt[1] = data;
	HAL_I2C_Master_Transmit(OLED_I2C, address, dt, 2, 10);
}

void OLED_I2C_IspisVisestruko(uint8_t address, uint8_t reg, uint8_t* data, uint16_t count) {
	uint8_t dt[256];
	dt[0] = reg;
	uint8_t i;
	for(i = 0; i < count; i++)
	dt[i+1] = data[i];
	HAL_I2C_Master_Transmit(OLED_I2C, address, dt, count+1, 10);
}

void OLED_AzurirajZaslon(void) {
	uint8_t m;

	for (m = 0; m < 8; m++) {
		OLED_WRITECOMMAND(0xB0 + m);
		OLED_WRITECOMMAND(0x00);
		OLED_WRITECOMMAND(0x10);

		OLED_I2C_IspisVisestruko(OLED_I2C_ADDR, 0x40, &OLED_Buffer[OLED_W * m], OLED_W);
	}
}

void OLED_Popuni(OLED_BOJA_t color) {

	/* posatvi memoriju */
	memset(OLED_Buffer, (color == OLED_CRNA) ? 0x00 : 0xFF, sizeof(OLED_Buffer));
}

	/* inicijalizacija OLED */

uint8_t OLED_Init(void) {

	OLED_I2C_Init();

	if (HAL_I2C_IsDeviceReady(OLED_I2C, OLED_I2C_ADDR, 1, 20000) != HAL_OK) {
		return 0;
	}

	uint32_t p = 2500;
	while(p>0)
		p--;

	OLED_WRITECOMMAND(0xAE);
	OLED_WRITECOMMAND(0x20);
	OLED_WRITECOMMAND(0x10);
	OLED_WRITECOMMAND(0xB0);
	OLED_WRITECOMMAND(0xC8);
	OLED_WRITECOMMAND(0x00);
	OLED_WRITECOMMAND(0x10);
	OLED_WRITECOMMAND(0x40);
	OLED_WRITECOMMAND(0x81);
	OLED_WRITECOMMAND(0xFF);
	OLED_WRITECOMMAND(0xA1);
	OLED_WRITECOMMAND(0xA6);
#if (OLED_H == 128)
	OLED_WRITECOMMAND(0xFF);
#else
	OLED_WRITECOMMAND(0xA8);
#endif

#if (OLED_H == 32)
	OLED_WRITECOMMAND(0x1F);
#elif (OLED_H == 64)
	OLED_WRITECOMMAND(0x3F);
#elif (OLED_H == 128)
	OLED_WRITECOMMAND(0x3F);
#endif
	OLED_WRITECOMMAND(0xA4);
	OLED_WRITECOMMAND(0xD3);
	OLED_WRITECOMMAND(0x00);
	OLED_WRITECOMMAND(0xD5);
	OLED_WRITECOMMAND(0xF0);
	OLED_WRITECOMMAND(0xD9);
	OLED_WRITECOMMAND(0x22);

	OLED_WRITECOMMAND(0xDA);
#if (OLED_H == 32)
	OLED_WRITECOMMAND(0x02);
#elif (OLED_H == 64)
	OLED_WRITECOMMAND(0x12);
#elif (OLED_H == 128)
	OLED_WRITECOMMAND(0x12);
#endif

	OLED_WRITECOMMAND(0xDB);
	OLED_WRITECOMMAND(0x20);
	OLED_WRITECOMMAND(0x8D);
	OLED_WRITECOMMAND(0x14);
	OLED_WRITECOMMAND(0xAF);


	OLED_WRITECOMMAND(OLED_DEAKTIVIRAJ_SCROLL);

	/* Čisti ekran (crna) */
	OLED_Popuni(OLED_CRNA);

	/* Osvježi ekran */
	OLED_AzurirajZaslon();

	/* Kordinate na (0, 0) */
	OLED.X = 0;
	OLED.Y = 0;

	/* Inicijalizacija je OK */
	OLED.Inicijalizirano = 1;

	/* Vrati OK */
	return 1;
}

	/* postavljanje koordinati */

void OLED_XY(uint16_t x, uint16_t y) {
	OLED.X = x;
	OLED.Y = y;
}

void OLED_Piksel(uint16_t x, uint16_t y, OLED_BOJA_t color) {
	if (
		x >= OLED_W ||
		y >= OLED_H
	) {
		return;
	}

	if (OLED.Obrnuto) {
		color = (OLED_BOJA_t) !color;
	}

	/* Postavi boju*/
	if (color == OLED_BIJELA) {
		OLED_Buffer[x + (y / 8) * OLED_W] |= 1 << (y % 8);
	} else {
		OLED_Buffer[x + (y / 8) * OLED_W] &= ~(1 << (y % 8));
	}
}

char OLED_Character(char ch, FontDef_t* Font, OLED_BOJA_t color) {
	uint32_t i, b, j;

	/* Provjeri ima li mjesta na OLED-u */
	if (
		OLED_W <= (OLED.X + Font->Font_W) ||
		OLED_H <= (OLED.Y + Font->Font_H)
	) {
		return 0;
	}

	for (i = 0; i < Font->Font_H; i++) {
			b = Font->data[(ch - 32) * Font->Font_H + i];
			for (j = 0; j < Font->Font_W; j++) {
				if ((b << j) & 0x8000) {
					OLED_Piksel(OLED.X + j, (OLED.Y + i), (OLED_BOJA_t) color);
				} else {
					OLED_Piksel(OLED.X + j, (OLED.Y + i), (OLED_BOJA_t)!color);
				}
			}
		}

	/* Povećaj pointer */
	OLED.X += Font->Font_W;

	/* Vraća charachter koji je napisan */
	return ch;
}

	/* ispis na OLED */
char OLED_String(char* str, FontDef_t* Font, OLED_BOJA_t color) {

	while (*str) {
		if (OLED_Character(*str, Font, color) != *str) {
			return *str;
		}

		str++;
	}

	return *str;
}

/* USER CODE END Includes */

/* Private typedef -----------------------------------------------------------*/
/* USER CODE BEGIN PTD */

/* USER CODE END PTD */

/* Private define ------------------------------------------------------------*/
/* USER CODE BEGIN PD */

/* USER CODE END PD */

/* Private macro -------------------------------------------------------------*/
/* USER CODE BEGIN PM */

/* USER CODE END PM */

/* Private variables ---------------------------------------------------------*/

/* USER CODE BEGIN PV */

/* USER CODE END PV */

/* Private function prototypes -----------------------------------------------*/
void SystemClock_Config(void);
/* USER CODE BEGIN PFP */

/* USER CODE END PFP */

/* Private user code ---------------------------------------------------------*/
/* USER CODE BEGIN 0 */
void HAL_TIM_IC_CaptureCallback(TIM_HandleTypeDef *htim)
{
	if (htim->Channel == HAL_TIM_ACTIVE_CHANNEL_1)
	{
		if (Zabiljezeno==0)
		{
			IC_Vrijednost1 = HAL_TIM_ReadCapturedValue(htim, TIM_CHANNEL_1);
			Zabiljezeno = 1;

			__HAL_TIM_SET_CAPTUREPOLARITY(htim, TIM_CHANNEL_1, TIM_INPUTCHANNELPOLARITY_FALLING);
		}

		else if (Zabiljezeno==1)
		{
			IC_Vrijednost2 = HAL_TIM_ReadCapturedValue(htim, TIM_CHANNEL_1);
			__HAL_TIM_SET_COUNTER(htim, 0);

			if (IC_Vrijednost2 > IC_Vrijednost1)
			{
				Razlika = IC_Vrijednost2-IC_Vrijednost1;
			}

			else if (IC_Vrijednost1 > IC_Vrijednost2)
			{
				Razlika = (0xffff - IC_Vrijednost1) + IC_Vrijednost2;
			}

			Udaljenost = Razlika * 0.034/2;
			Zabiljezeno = 0;

			__HAL_TIM_SET_CAPTUREPOLARITY(htim, TIM_CHANNEL_1, TIM_INPUTCHANNELPOLARITY_RISING);
			__HAL_TIM_DISABLE_IT(&htim1, TIM_IT_CC1);
		}
	}
}
void HCSR04 (void)
	{
		HAL_GPIO_WritePin(GPIOA, GPIO_PIN_9, GPIO_PIN_SET);
		HAL_Delay(10);
		HAL_GPIO_WritePin(GPIOA, GPIO_PIN_9, GPIO_PIN_RESET);

		__HAL_TIM_ENABLE_IT(&htim1, TIM_IT_CC1);
	}
/* USER CODE END 0 */

/**
  * @brief  The application entry point.
  * @retval int
  */
int main(void)
{

  /* USER CODE BEGIN 1 */

  /* USER CODE END 1 */

  /* MCU Configuration--------------------------------------------------------*/

  /* Reset of all peripherals, Initializes the Flash interface and the Systick. */
  HAL_Init();

  /* USER CODE BEGIN Init */

  /* USER CODE END Init */

  /* Configure the system clock */
  SystemClock_Config();

  /* USER CODE BEGIN SysInit */

  /* USER CODE END SysInit */

  /* Initialize all configured peripherals */
  MX_GPIO_Init();
  MX_TIM1_Init();
  MX_TIM2_Init();
  MX_I2C1_Init();
  MX_TIM3_Init();
  /* USER CODE BEGIN 2 */

  // TIM1

  HAL_TIM_IC_Start_IT(&htim1, TIM_CHANNEL_1);

  // MOTOR 1

  HAL_TIM_PWM_Start(&htim2, TIM_CHANNEL_1);
  HAL_TIM_PWM_Start(&htim2, TIM_CHANNEL_2);

  // MOTOR 2

  HAL_TIM_PWM_Start(&htim3, TIM_CHANNEL_1);
  HAL_TIM_PWM_Start(&htim3, TIM_CHANNEL_2);

  /* USER CODE END 2 */

  /* Infinite loop */
  /* USER CODE BEGIN WHILE */
  while (1)
  {
	  OLED_Init();
	  OLED_XY (10,20);
	  OLED_String ("Udaljenost", &Font_11x18, 1);
	  snprintf(Udaljenost_ch, sizeof(Udaljenost_ch), "%d", Udaljenost);
	  OLED_XY (10, 40);
	  OLED_String (Udaljenost_ch, &Font_11x18, 1);
	  OLED_XY (45, 40);
	  OLED_String ("cm", &Font_11x18, 1);
	  OLED_AzurirajZaslon();

	  while (HAL_GPIO_ReadPin(GPIOB, GPIO_PIN_5)){ // PIR sensor

		  HCSR04();
		  HAL_Delay(200);

		  if(Udaljenost < 15){ // HC-SR04

			  __HAL_TIM_SET_COMPARE(&htim2, TIM_CHANNEL_1, 0);
			  __HAL_TIM_SET_COMPARE(&htim2, TIM_CHANNEL_2, 70);

			  __HAL_TIM_SET_COMPARE(&htim3, TIM_CHANNEL_1, 70);
			  __HAL_TIM_SET_COMPARE(&htim3, TIM_CHANNEL_2,  0);


		  } else {

			  __HAL_TIM_SET_COMPARE(&htim2, TIM_CHANNEL_1, 0);
			  __HAL_TIM_SET_COMPARE(&htim2, TIM_CHANNEL_2, 0);

			  __HAL_TIM_SET_COMPARE(&htim3, TIM_CHANNEL_1, 0);
			  __HAL_TIM_SET_COMPARE(&htim3, TIM_CHANNEL_2, 0);
		  }
	  }

  }
    /* USER CODE END WHILE */

    /* USER CODE BEGIN 3 */

  /* USER CODE END 3 */
}

/**
  * @brief System Clock Configuration
  * @retval None
  */
void SystemClock_Config(void)
{
  RCC_OscInitTypeDef RCC_OscInitStruct = {0};
  RCC_ClkInitTypeDef RCC_ClkInitStruct = {0};

  /** Configure the main internal regulator output voltage
  */
  __HAL_RCC_PWR_CLK_ENABLE();
  __HAL_PWR_VOLTAGESCALING_CONFIG(PWR_REGULATOR_VOLTAGE_SCALE3);

  /** Initializes the RCC Oscillators according to the specified parameters
  * in the RCC_OscInitTypeDef structure.
  */
  RCC_OscInitStruct.OscillatorType = RCC_OSCILLATORTYPE_HSI;
  RCC_OscInitStruct.HSIState = RCC_HSI_ON;
  RCC_OscInitStruct.HSICalibrationValue = RCC_HSICALIBRATION_DEFAULT;
  RCC_OscInitStruct.PLL.PLLState = RCC_PLL_NONE;
  if (HAL_RCC_OscConfig(&RCC_OscInitStruct) != HAL_OK)
  {
    Error_Handler();
  }

  /** Initializes the CPU, AHB and APB buses clocks
  */
  RCC_ClkInitStruct.ClockType = RCC_CLOCKTYPE_HCLK|RCC_CLOCKTYPE_SYSCLK
                              |RCC_CLOCKTYPE_PCLK1|RCC_CLOCKTYPE_PCLK2;
  RCC_ClkInitStruct.SYSCLKSource = RCC_SYSCLKSOURCE_HSI;
  RCC_ClkInitStruct.AHBCLKDivider = RCC_SYSCLK_DIV1;
  RCC_ClkInitStruct.APB1CLKDivider = RCC_HCLK_DIV1;
  RCC_ClkInitStruct.APB2CLKDivider = RCC_HCLK_DIV1;

  if (HAL_RCC_ClockConfig(&RCC_ClkInitStruct, FLASH_LATENCY_0) != HAL_OK)
  {
    Error_Handler();
  }
}

/* USER CODE BEGIN 4 */

/* USER CODE END 4 */

/**
  * @brief  This function is executed in case of error occurrence.
  * @retval None
  */
void Error_Handler(void)
{
  /* USER CODE BEGIN Error_Handler_Debug */
  /* User can add his own implementation to report the HAL error return state */
  __disable_irq();
  while (1)
  {
  }
  /* USER CODE END Error_Handler_Debug */
}

#ifdef  USE_FULL_ASSERT
/**
  * @brief  Reports the name of the source file and the source line number
  *         where the assert_param error has occurred.
  * @param  file: pointer to the source file name
  * @param  line: assert_param error line source number
  * @retval None
  */
void assert_failed(uint8_t *file, uint32_t line)
{
  /* USER CODE BEGIN 6 */
  /* User can add his own implementation to report the file name and line number,
     ex: printf("Wrong parameters value: file %s on line %d\r\n", file, line) */
  /* USER CODE END 6 */
}
#endif /* USE_FULL_ASSERT */
